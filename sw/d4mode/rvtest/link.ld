OUTPUT_ARCH(riscv)
ENTRY(_start)
SECTIONS
{
  . = 0x80200000;
  .text : { *(.text.start) *(.text*) }
  .rodata : { *(.rodata*) }
  .data : { *(.data*) *(.sdata*) }
  .bss : { *(.bss*) *(.sbss*) *(COMMON) }
}
